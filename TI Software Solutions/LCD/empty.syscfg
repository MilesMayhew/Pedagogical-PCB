/**
 * @cliArgs --device "MSPM0G350X" --part "Default" --package "LQFP-64(PM)" --product "mspm0_sdk@2.08.00.02"
 * @versions {"tool":"1.25.0+4268"}
 */

/**
 * Import the modules used in this configuration.
 */
const GPIO   = scripting.addModule("/ti/driverlib/GPIO", {}, false);
const GPIO1  = GPIO.addInstance();
const SPI    = scripting.addModule("/ti/driverlib/SPI", {}, false);
const SPI1   = SPI.addInstance();
const SYSCTL = scripting.addModule("/ti/driverlib/SYSCTL");

/**
 * Write custom configuration values to the imported modules.
 */
GPIO1.$name                          = "GPIO_GRP_0";
GPIO1.associatedPins.create(3);
GPIO1.associatedPins[0].initialValue = "SET";
GPIO1.associatedPins[0].$name        = "LCD_CS";
GPIO1.associatedPins[0].assignedPort = "PORTB";
GPIO1.associatedPins[0].assignedPin  = "1";
GPIO1.associatedPins[1].$name        = "LCD_DC";
GPIO1.associatedPins[1].assignedPort = "PORTB";
GPIO1.associatedPins[1].assignedPin  = "2";
GPIO1.associatedPins[2].$name        = "LCD_RES";
GPIO1.associatedPins[2].assignedPort = "PORTB";

const Board = scripting.addModule("/ti/driverlib/Board", {}, false);

SPI1.$name               = "SPI_0";
SPI1.phase               = "1";
SPI1.sclkPinConfig.$name = "ti_driverlib_gpio_GPIOPinGeneric0";
SPI1.mosiPinConfig.$name = "ti_driverlib_gpio_GPIOPinGeneric1";
SPI1.misoPinConfig.$name = "ti_driverlib_gpio_GPIOPinGeneric2";
SPI1.cs0PinConfig.$name  = "ti_driverlib_gpio_GPIOPinGeneric3";

SYSCTL.forceDefaultClkConfig = true;

/**
 * Pinmux solution for unlocked pins/peripherals. This ensures that minor changes to the automatic solver in a future
 * version of the tool will not impact the pinmux you originally saw.  These lines can be completely deleted in order to
 * re-solve from scratch.
 */
GPIO1.associatedPins[0].pin.$suggestSolution = "PB1";
GPIO1.associatedPins[1].pin.$suggestSolution = "PB2";
GPIO1.associatedPins[2].pin.$suggestSolution = "PB13";
Board.peripheral.$suggestSolution            = "DEBUGSS";
Board.peripheral.swclkPin.$suggestSolution   = "PA20";
Board.peripheral.swdioPin.$suggestSolution   = "PA19";
SPI1.peripheral.$suggestSolution             = "SPI0";
SPI1.peripheral.sclkPin.$suggestSolution     = "PA11";
SPI1.peripheral.mosiPin.$suggestSolution     = "PA14";
SPI1.peripheral.misoPin.$suggestSolution     = "PA10";
SPI1.peripheral.cs0Pin.$suggestSolution      = "PA2";
SYSCTL.peripheral.$suggestSolution           = "SYSCTL";
